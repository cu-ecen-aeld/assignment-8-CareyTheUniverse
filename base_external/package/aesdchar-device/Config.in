## base_external/package/aesdchar-device/Config.in
```kconfig
config BR2_PACKAGE_AESDCHAR_DEVICE
	bool "aesdchar-device"
	help
	  Includes driver for aesdchar device.
```

## base_external/package/aesdchar/Config.in
```kconfig
config BR2_PACKAGE_AESDCHAR
	bool "aesdchar"
	help
	  Includes driver for aesdchar device.
```

## base_external/package/ldd/Config.in
```kconfig
config BR2_PACKAGE_LDD
	bool "ldd"
	help
		Supports misc-modules and scull components.
```
